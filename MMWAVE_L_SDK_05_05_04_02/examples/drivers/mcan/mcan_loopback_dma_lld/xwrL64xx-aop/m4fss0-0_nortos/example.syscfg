/**
 * @cliArgs --device "XWRL64XX" --package "AOP" --part "Default" --context "m4fss0-0" --product "MMWAVE-L-SDK@05.00.00"
 * @versions {"tool":"1.17.0+3128"}
 */

/**
 * Import the modules used in this configuration.
 */
const edma       = scripting.addModule("/drivers/edma/edma", {}, false);
const edma1      = edma.addInstance();
const mcan       = scripting.addModule("/drivers/mcan/mcan", {}, false);
const mcan1      = mcan.addInstance();
const debug_log  = scripting.addModule("/kernel/dpl/debug_log");
const mpu_armv7  = scripting.addModule("/kernel/dpl/mpu_armv7", {}, false);
const mpu_armv71 = mpu_armv7.addInstance();
const mpu_armv72 = mpu_armv7.addInstance();
const mpu_armv73 = mpu_armv7.addInstance();

/**
 * Write custom configuration values to the imported modules.
 */
mcan1.$name           = "CONFIG_MCAN0";
mcan1.MCAN.$assign    = "MCAN0";
mcan1.MCAN.RX.$assign = "PAD_AM";
mcan1.MCAN.TX.$assign = "PAD_AN";

debug_log.enableUartLog           = true;
debug_log.uartLog.$name           = "CONFIG_UART0";
debug_log.uartLog.UART.RX.$assign = "PAD_AP";
debug_log.uartLog.UART.TX.$assign = "PAD_AO";

edma1.$name                             = "CONFIG_EDMA0";
debug_log.uartLog.edmaConfig            = edma1;
edma1.edmaRmDmaCh[0].$name              = "CONFIG_EDMA_RM0";
edma1.edmaRmQdmaCh[0].$name             = "CONFIG_EDMA_RM1";
edma1.edmaRmTcc[0].$name                = "CONFIG_EDMA_RM2";
edma1.edmaRmParam[0].$name              = "CONFIG_EDMA_RM3";
edma1.edmaRmReservedDmaCh[0].$name      = "CONFIG_EDMA_RM4";
edma1.edmaRmReservedDmaCh[0].startIndex = 8;
edma1.edmaRmReservedDmaCh[0].endIndex   = 9;

mpu_armv71.$name        = "CONFIG_MPU_REGION0";
mpu_armv71.attributes   = "Device";
mpu_armv71.allowExecute = false;

mpu_armv72.$name    = "CONFIG_MPU_REGION1";
mpu_armv72.baseAddr = 0x400000;
mpu_armv72.size     = 19;

mpu_armv73.$name    = "CONFIG_MPU_REGION2";
mpu_armv73.baseAddr = 0x22400000;
mpu_armv73.size     = 19;

/**
 * Pinmux solution for unlocked pins/peripherals. This ensures that minor changes to the automatic solver in a future
 * version of the tool will not impact the pinmux you originally saw.  These lines can be completely deleted in order to
 * re-solve from scratch.
 */
debug_log.uartLog.UART.$suggestSolution = "UARTB";
