/**
 * @cliArgs --device "XWRL64XX" --package "AOP" --part "Default" --context "m4fss0-0" --product "MMWAVE-L-SDK@05.00.00"
 * @versions {"tool":"1.17.0+3128"}
 */

/**
 * Import the modules used in this configuration.
 */
const qspi       = scripting.addModule("/drivers/qspi/qspi", {}, false);
const qspi1      = qspi.addInstance();
const clock      = scripting.addModule("/kernel/dpl/clock");
const debug_log  = scripting.addModule("/kernel/dpl/debug_log");
const mpu_armv7  = scripting.addModule("/kernel/dpl/mpu_armv7", {}, false);
const mpu_armv71 = mpu_armv7.addInstance();
const mpu_armv72 = mpu_armv7.addInstance();
const mpu_armv73 = mpu_armv7.addInstance();

/**
 * Write custom configuration values to the imported modules.
 */
qspi1.$name     = "CONFIG_QSPI0";
qspi1.advanced  = true;
qspi1.dataDelay = "DELAY_1";

debug_log.enableUartLog           = true;
debug_log.uartLog.$name           = "CONFIG_UART0";
debug_log.uartLog.UART.RX.$assign = "PAD_AP";
debug_log.uartLog.UART.TX.$assign = "PAD_AO";

const edma                         = scripting.addModule("/drivers/edma/edma", {}, false);
const edma1                        = edma.addInstance({}, false);
qspi1.edmaConfig                   = edma1;
debug_log.uartLog.edmaConfig       = edma1;
edma1.$name                        = "CONFIG_EDMA0";
edma1.edmaRmDmaCh[0].$name         = "CONFIG_EDMA_RM0";
edma1.edmaRmQdmaCh[0].$name        = "CONFIG_EDMA_RM1";
edma1.edmaRmTcc[0].$name           = "CONFIG_EDMA_RM2";
edma1.edmaRmParam[0].$name         = "CONFIG_EDMA_RM3";
edma1.edmaRmReservedDmaCh[0].$name = "CONFIG_EDMA_RM4";

mpu_armv71.$name        = "CONFIG_MPU_REGION0";
mpu_armv71.attributes   = "Device";
mpu_armv71.allowExecute = false;

mpu_armv72.$name    = "CONFIG_MPU_REGION1";
mpu_armv72.baseAddr = 0x400000;
mpu_armv72.size     = 19;

mpu_armv73.$name    = "CONFIG_MPU_REGION2";
mpu_armv73.baseAddr = 0x22400000;
mpu_armv73.size     = 19;

/**
 * Pinmux solution for unlocked pins/peripherals. This ensures that minor changes to the automatic solver in a future
 * version of the tool will not impact the pinmux you originally saw.  These lines can be completely deleted in order to
 * re-solve from scratch.
 */
qspi1.QSPI.$suggestSolution             = "QSPI0";
qspi1.QSPI.DOUT.$suggestSolution        = "PAD_AC";
qspi1.QSPI.DIN.$suggestSolution         = "PAD_AD";
qspi1.QSPI.DIN0.$suggestSolution        = "PAD_AE";
qspi1.QSPI.DIN1.$suggestSolution        = "PAD_AF";
qspi1.QSPI.CLK.$suggestSolution         = "PAD_AA";
qspi1.QSPI.CS.$suggestSolution          = "PAD_AB";
debug_log.uartLog.UART.$suggestSolution = "UARTB";
