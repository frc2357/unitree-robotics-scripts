/**
 * @cliArgs --device "XWRL64XX" --package "FCCSP" --part "Default" --context "m4fss0-0" --product "MMWAVE-L-SDK@05.00.00"
 * @versions {"tool":"1.13.0+2553"}
 */

/**
 * Import the modules used in this configuration.
 */
const edma  = scripting.addModule("/drivers/edma/edma", {}, false);
const edma1 = edma.addInstance();
const hwa   = scripting.addModule("/drivers/hwa/hwa", {}, false);
const hwa1  = hwa.addInstance();

/**
 * Write custom configuration values to the imported modules.
 */
edma1.$name                        = "CONFIG_EDMA0";
edma1.instance                     = "EDMA_APPSS_B";
edma1.edmaRmDmaCh[0].$name         = "CONFIG_EDMA_RM0";
edma1.edmaRmQdmaCh[0].$name        = "CONFIG_EDMA_RM1";
edma1.edmaRmTcc[0].$name           = "CONFIG_EDMA_RM2";
edma1.edmaRmParam[0].$name         = "CONFIG_EDMA_RM3";
edma1.edmaRmReservedDmaCh[0].$name = "CONFIG_EDMA_RM4";

hwa1.$name = "CONFIG_HWA0";
